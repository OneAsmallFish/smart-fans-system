## firmware/sdkconfig.defaults
```kconfig
# ESP32-S3 Smart Fan Controller — sdkconfig defaults

# Target
CONFIG_IDF_TARGET="esp32s3"

# Flash: ESP32-S3-N16R8 (16MB Flash, 8MB Octal PSRAM)
CONFIG_ESPTOOLPY_FLASHSIZE_16MB=y
CONFIG_ESPTOOLPY_FLASHSIZE="16MB"
CONFIG_ESPTOOLPY_FLASHMODE_QIO=y
CONFIG_ESPTOOLPY_FLASHFREQ_80M=y

# PSRAM
CONFIG_SPIRAM=y
CONFIG_SPIRAM_MODE_OCT=y
CONFIG_SPIRAM_SPEED_80M=y
CONFIG_SPIRAM_FETCH_INSTRUCTIONS=y
CONFIG_SPIRAM_RODATA=y

# Partition table
CONFIG_PARTITION_TABLE_CUSTOM=y
CONFIG_PARTITION_TABLE_CUSTOM_FILENAME="partitions.csv"

# FreeRTOS
CONFIG_FREERTOS_HZ=1000
CONFIG_FREERTOS_UNICORE=n
CONFIG_ESP_MAIN_TASK_STACK_SIZE=8192
CONFIG_FREERTOS_TIMER_TASK_STACK_DEPTH=4096

# WiFi
CONFIG_ESP_WIFI_ENABLED=y
CONFIG_ESP_WIFI_STA_ENABLED=y
CONFIG_ESP_WIFI_SOFTAP_ENABLED=y
CONFIG_ESP_WIFI_STATIC_RX_BUFFER_NUM=10
CONFIG_ESP_WIFI_DYNAMIC_RX_BUFFER_NUM=32

# MQTT
CONFIG_MQTT_PROTOCOL_311=y
CONFIG_MQTT_TRANSPORT_SSL=y
CONFIG_MQTT_BUFFER_SIZE=4096

# USB-CDC (ESP32-S3 native USB OTG)
CONFIG_TINYUSB_ENABLED=y
CONFIG_TINYUSB_CDC_ENABLED=y
CONFIG_TINYUSB_CDC_RX_BUFSIZE=512
CONFIG_TINYUSB_CDC_TX_BUFSIZE=512

# NVS
CONFIG_NVS_ENCRYPTION=n

# OTA
CONFIG_BOOTLOADER_APP_ROLLBACK_ENABLE=y

# ADC
CONFIG_ADC_DISABLE_DAC=n
CONFIG_ADC_ONESHOT_CTRL_FUNC_IN_IRAM=y

# SNTP
CONFIG_LWIP_SNTP=y
CONFIG_LWIP_SNTP_UPDATE_DELAY=30000

# Logging
CONFIG_LOG_DEFAULT_LEVEL_INFO=y
CONFIG_LOG_COLORS=y

# Wear levelling (for storage partition)
CONFIG_WL_SECTOR_SIZE_512=y

# Task watchdog
CONFIG_ESP_TASK_WDT_TIMEOUT_S=30

# Power management (disable for server PSU use)
CONFIG_PM_ENABLE=n
```
